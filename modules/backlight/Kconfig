## modules/backlight/Kconfig
```kconfig
config DEFY_BACKLIGHT
        tristate "Defy: handle button backlight brightness"
        default m
        depends on SYMSEARCH
```

## modules/clockfix/Kconfig
```kconfig
config DEFY_CLOCKFIX
        tristate "Defy: Fix dmesg warnings in clocks like 1.3GHz"
        default m
        depends on SYMSEARCH
```

## modules/gpiofix/Kconfig
```kconfig
config DEFY_GPIOFIX
        tristate "Defy: Fix Touch panel GPIO Hardware Reset"
        default m
        depends on SYMSEARCH
```

## modules/ledsfix/Kconfig
```kconfig
config DEFY_LEDSFIX
        tristate "Defy: fix brightness levels for soft buttons"
        default m
        depends on SYMSEARCH
```

## modules/logcap/Kconfig
```kconfig
config DEFY_LOGCAP
        tristate "Defy: log cpcap registers read/write"
        default m
        depends on SYMSEARCH
```

## modules/multitouch/Kconfig
```kconfig
config QTOUCH_MULTITOUCH
        tristate "Multitouch 1 to 16 points for Defy"
        default m
```

## modules/overclock/Kconfig
```kconfig
menu "Defy Overclock"
	depends on ARCH_OMAP3
config  CPUFREQ_OVERCLOCK
	bool "overclock"
	default y
config  CPUFREQ_GOV_BOOSTED
	bool "smartass2 boosted variant"
	default y
config  CPUFREQ_GOV_INTERACTIVE
	bool "interactive"
	default y
config  CPUFREQ_GOV_CONSERVATIVE
	bool "conservative"
	default y
config  CPUFREQ_GOV_POWERSAVE
        bool "powersave"
        default y
config  CPUFREQ_STAT
	bool "stats"
	default y
endmenu
```

## modules/proximity/Kconfig
```kconfig
config DEFY_PROXIMITY
        tristate "Defy: Proximity sensor registers (missing data in original devtree)"
        default m
        depends on SYMSEARCH
```

## modules/symsearch/Kconfig
```kconfig
config SYMSEARCH
        tristate "Symsearch, to use kernel symbols in modules"
        default m
```

## modules/usbled/Kconfig
```kconfig
config LEDS_DEFY_USB
        tristate "White LED Support for Defy device"
        default m
        depends on LEDS_CLASS && MFD_CPCAP
        help
          This option enables support for white LED on Defy.
```
